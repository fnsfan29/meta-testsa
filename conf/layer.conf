## conf/layer.conf
```bitbake
# We have a conf and classes directory, add to BBPATH
BBPATH .= ":${LAYERDIR}"

# We have recipes-* directories, add to BBFILES
BBFILES += "${LAYERDIR}/recipes-*/*/*.bb \
            ${LAYERDIR}/recipes-*/*/*.bbappend"

BBFILE_COLLECTIONS += "meta-testsa"
BBFILE_PATTERN_meta-testsa = "^${LAYERDIR}/"
BBFILE_PRIORITY_meta-testsa = "6"

LAYERDEPENDS_meta-testsa = "core"
LAYERSERIES_COMPAT_meta-testsa = "hardknott"
```
